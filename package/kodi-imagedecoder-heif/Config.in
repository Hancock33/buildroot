## package/kodi-imagedecoder-heif/Config.in
```kconfig
config BR2_PACKAGE_KODI_IMAGEDECODER_HEIF
	bool "kodi-imagedecoder-heif"
	select BR2_PACKAGE_LIBDE265
	select BR2_PACKAGE_LIBHEIF
	select BR2_PACKAGE_TINYXML2
	help
	  HEIF image decoder add-on for Kodi

	  https://github.com/xbmc/imagedecoder.heif
```

## package/kodi-imagedecoder-raw/Config.in
```kconfig
config BR2_PACKAGE_KODI_IMAGEDECODER_RAW
	bool "kodi-imagedecoder-raw"
	select BR2_PACKAGE_JPEG
	select BR2_PACKAGE_LCMS2
	select BR2_PACKAGE_LIBRAW
	help
	  RAW image decoder add-on for Kodi

	  https://github.com/xbmc/imagedecoder.raw
```

## package/libgtk4/Config.in
```kconfig
comment "libgtk4 needs a toolchain w/ wchar, threads, C++, gcc >= 4.9"
	depends on BR2_USE_MMU
	depends on BR2_TOOLCHAIN_HAS_SYNC_4
	depends on !BR2_USE_WCHAR || !BR2_INSTALL_LIBSTDCPP || \
		!BR2_TOOLCHAIN_GCC_AT_LEAST_4_9 || \
		!BR2_TOOLCHAIN_HAS_THREADS

comment "libgtk4 needs an OpenGL or an OpenGL-EGL/wayland backend"
	depends on BR2_USE_MMU
	depends on BR2_TOOLCHAIN_HAS_SYNC_4
	depends on !BR2_PACKAGE_HAS_LIBEGL_WAYLAND && !BR2_PACKAGE_HAS_LIBGL

config BR2_PACKAGE_LIBGTK4
	bool "libgtk4"
	depends on BR2_USE_WCHAR # glib2
	depends on BR2_TOOLCHAIN_HAS_THREADS # glib2
	depends on BR2_USE_MMU # glib2
	depends on BR2_INSTALL_LIBSTDCPP # pango
	depends on BR2_TOOLCHAIN_HAS_SYNC_4 # pango -> harfbuzz
	depends on BR2_TOOLCHAIN_GCC_AT_LEAST_4_9 # pango -> harfbuzz
	depends on BR2_PACKAGE_HAS_LIBEGL_WAYLAND || BR2_PACKAGE_HAS_LIBGL
	select BR2_PACKAGE_CAIRO
	select BR2_PACKAGE_CAIRO_PS
	select BR2_PACKAGE_CAIRO_PDF
	select BR2_PACKAGE_CAIRO_SVG
	select BR2_PACKAGE_GDK_PIXBUF
	select BR2_PACKAGE_GRAPHENE
	select BR2_PACKAGE_LIBEPOXY
	select BR2_PACKAGE_LIBGLIB2
	select BR2_PACKAGE_PANGO
	select BR2_PACKAGE_TIFF
	# At least one backend is required
	select BR2_PACKAGE_LIBGTK4_BROADWAY if \
		!(BR2_PACKAGE_LIBGTK4_X11 || BR2_PACKAGE_LIBGTK4_WAYLAND)
	help
	  The GTK version 4 graphical user interface library

	  https://www.gtk.org/

if BR2_PACKAGE_LIBGTK4

config BR2_PACKAGE_LIBGTK4_BROADWAY
	bool "Broadway GDK backend"
	default y
	  help
	  This enables the Broadway backend for GDK, which provides
	  support for displaying GTK+ applications in a web browser,
	  using HTML5 and web sockets.

	  For example, to run gtk4-demo on a target which IP address is
	  192.168.0.1 and use it from a web browser, execute the
	  following commands:

	  $ broadwayd -a 192.168.0.1 -p 8080 :2 &
	  $ export GDK_BACKEND=broadway
	  $ export BROADWAY_DISPLAY=:2
	  $ gtk4-demo

	  Then open a web browser at address http://192.168.0.1:8080.
	  Javascript and web sockets should be enabled.

comment "Wayland GDK backend needs an OpenGL EGL backend provided by mesa3d w/ headers >= 3.17"
	depends on !BR2_PACKAGE_MESA3D_OPENGL_EGL || !BR2_TOOLCHAIN_HEADERS_AT_LEAST_3_17

config BR2_PACKAGE_LIBGTK4_WAYLAND
	bool "Wayland GDK backend"
	default y
	depends on BR2_PACKAGE_HAS_LIBEGL_WAYLAND
	depends on BR2_TOOLCHAIN_HEADERS_AT_LEAST_3_17
	select BR2_PACKAGE_WAYLAND
	select BR2_PACKAGE_LIBXKBCOMMON
	help
	  This enables the Wayland backend for GDK.

comment "X11 GDK backend needs an OpenGL provider"
	depends on !BR2_PACKAGE_HAS_LIBGL

config BR2_PACKAGE_LIBGTK4_X11
	bool "X11 GDK backend"
	default y
	depends on BR2_PACKAGE_XORG7
	depends on BR2_PACKAGE_HAS_LIBGL
	select BR2_PACKAGE_XLIB_LIBXCURSOR
	select BR2_PACKAGE_XLIB_LIBXI
	select BR2_PACKAGE_XLIB_LIBXINERAMA
	help
	  This enables the X11 backend for GDK.

config BR2_PACKAGE_LIBGTK4_GSTREAMER
	bool "gstreamer support"
	select BR2_PACKAGE_GSTREAMER1
	select BR2_PACKAGE_GST1_PLUGINS_BASE
	select BR2_PACKAGE_GST1_PLUGINS_BASE_LIB_OPENGL
	select BR2_PACKAGE_GST1_PLUGINS_BAD
	help
	  Enable gstreamer support.

config BR2_PACKAGE_LIBGTK4_DEMO
	bool "Install libgtk4 demo/example programs"
	select BR2_PACKAGE_SHARED_MIME_INFO
	select BR2_PACKAGE_HICOLOR_ICON_THEME
	help
	  The GTK source base contains demo/exmaple programs.
	  This option allows to install them to the target.

endif
```

## package/libheif/Config.in
```kconfig
config BR2_PACKAGE_LIBHEIF
	bool "libheif"
	# avoid build error
	# Internal error in emit_expr_encoded at dw2gencfi.c:215
	depends on !BR2_m68k_cf
	depends on BR2_INSTALL_LIBSTDCPP
	help
	  libheif is an HEIF and AVIF file format decoder and encoder.

	  https://github.com/strukturag/libheif

comment "libheif needs a toolchain w/ C++"
	depends on !BR2_m68k_cf
	depends on !BR2_INSTALL_LIBSTDCPP
```

## package/linux-headers/Config.in
```kconfig
config BR2_PACKAGE_LINUX_HEADERS
	bool

config BR2_KERNEL_HEADERS_PATCHES
	string "Custom kernel patches"
	help
	  A space-separated list of patches to apply to the
	  kernel. Each patch can be described as an URL, a local file
	  path, or a directory. In the case of a directory, all files
	  matching *.patch in the directory will be applied.
```

## package/lpeg/Config.in
```kconfig
config BR2_PACKAGE_LPEG
	bool "lpeg"
	select BR2_PACKAGE_LUA
	help
	  LPeg is a new pattern-matching library for Lua,
	  based on Parsing Expression Grammars (PEGs).

	  http://www.inf.puc-rio.br/~roberto/lpeg.html
```

## package/mold/Config.in
```kconfig
config BR2_PACKAGE_MOLD
	bool "mold"
	depends on BR2_USE_WCHAR
	select BR2_PACKAGE_ZLIB
	select BR2_PACKAGE_TBB

	help
	  Mold: A Modern Linker

	  https://github.com/rui314/mold
```

## package/qt6/qt6multimedia/Config.in
```kconfig
config BR2_PACKAGE_QT6MULTIMEDIA
	bool "qt6multimedia"
	select BR2_PACKAGE_QT6BASE_GUI
	select BR2_PACKAGE_QT6BASE_NETWORK
	select BR2_PACKAGE_QT6BASE_OPENGL_DESKTOP
	select BR2_PACKAGE_QT6SHADERTOOLS

	help
	  Qt is a cross-platform application and UI framework for
	  developers using C++.

	  The Qt Multimedia module provides a rich feature set that
	  enables you to easily take advantage of a platform's
	  multimedia capabilities such as media playback and the use
	  of camera and radio devices.

	  https://doc.qt.io/qt-6/multimediaoverview.html
```

## package/qt6/qt6shadertools/Config.in
```kconfig
config BR2_PACKAGE_QT6SHADERTOOLS
	bool "qt6shadertools"
	select BR2_PACKAGE_QT6BASE_GUI
	select BR2_PACKAGE_QT6BASE_OPENGL_DESKTOP

	help

	  The Qt Shader Tools module builds on the SPIR-V Open Source Ecosystem
	  as described at the Khronos SPIR-V web site.

	  https://doc.qt.io/qt-6/qtshadertools-index.html
```

## package/spirv-llvm-translator/Config.in
```kconfig
config BR2_PACKAGE_SPIRV_LLVM_TRANSLATOR
	bool "spirv-llvm-translator"
	depends on BR2_INSTALL_LIBSTDCPP
	help
	  A tool and a library for bi-directional translation 
	  between SPIR-V and LLVM IR

	  https://www.khronos.org/registry/spir-v

comment "spirv-llvm-translator needs a toolchain w/ C++"
	depends on !BR2_INSTALL_LIBSTDCPP
```

## package/x11r7/xapp_bdftopcf/Config.in
```kconfig
config BR2_PACKAGE_XAPP_BDFTOPCF
	bool "bdftopcf"
	select BR2_PACKAGE_XLIB_LIBXFONT2
	help
	  X.Org bdftopcf application
```

## package/x11r7/xlib_libXpresent/Config.in
```kconfig
config BR2_PACKAGE_XLIB_LIBXPRESENT
	bool "libXpresent"
	select BR2_PACKAGE_XLIB_LIBXEXT
	select BR2_PACKAGE_XLIB_LIBXFIXES
	select BR2_PACKAGE_XLIB_XTRANS
	select BR2_PACKAGE_XORGPROTO
	help
	  X.Org Xpresent library
```
