## boot/qoriq-ddr-phy-binary/Config.in
```kconfig
config BR2_TARGET_QORIQ_DDR_PHY_BINARY
	bool "qoriq-ddr-phy-binary"
	depends on BR2_aarch64
	help
	  Firmware binary for DDR PHY of NXP LX2160A family of SoCs.
	  This package downloads and installs such firmware, which
	  is needed to build the ATF.

	  https://github.com/nxp-qoriq/ddr-phy-binary
```

## package/libmad/Config.in
```kconfig
config BR2_PACKAGE_LIBMAD
	bool "libmad"
	help
	  High-quality MPEG audio decoder. All computations are
	  performed with fixed-point integer arithmetic, making it ideal
	  for systems without a floating-point unit.

	  https://codeberg.org/tenacityteam/libmad

if BR2_PACKAGE_LIBMAD

choice
	prompt "Speed vs. accuracy"
	default BR2_PACKAGE_LIBMAD_OPTIMIZATION_SPEED

config BR2_PACKAGE_LIBMAD_OPTIMIZATION_SPEED
	bool "Optimize for speed over accuracy"
	help
	  Compromise accuracy for speed. This also enables the
	  subband synthesis optimization.

config BR2_PACKAGE_LIBMAD_OPTIMIZATION_ACCURACY
	bool "Optimize for accuracy over speed"
	help
	  Compromise speed for accuracy.

endchoice

config BR2_PACKAGE_LIBMAD_ASO
	bool "Architecture-specific optimizations"
	default y
	help
	  Use certain architecture-specific optimizations.

endif
```

## package/llvm-project/llvm-openmp/Config.in
```kconfig
config BR2_PACKAGE_LLVM_OPENMP
	bool "llvm-openmp"
	depends on BR2_PACKAGE_LLVM_ARCH_SUPPORTS
	depends on BR2_HOST_GCC_AT_LEAST_7 # host-llvm
	select BR2_HOST_CMAKE_AT_LEAST_3_20 # cmake required version at least 3.20
	help
	  LLVM's OpenMP runtime library (libomp) provides a high-performance
	  implementation of the OpenMP API specification for shared-memory
	  parallel programming. 

	  http://openmp.llvm.org/

comment "llvm-openmp needs host gcc >= 7"
	depends on BR2_PACKAGE_LLVM_ARCH_SUPPORTS
	depends on !BR2_HOST_GCC_AT_LEAST_7
```

## package/python-jc/Config.in
```kconfig
config BR2_PACKAGE_PYTHON_JC
	bool "python-jc"
	select BR2_PACKAGE_PYTHON_PYGMENTS # runtime
	select BR2_PACKAGE_PYTHON_RUAMEL_YAML # runtime
	select BR2_PACKAGE_PYTHON_XMLTODICT # runtime
	help
	  Converts the output of popular command-line tools and file-
	  types to JSON.

	  Optionally requires python-pygments for syntax highlighting,
	  python-ruamel-yaml for yaml parsing and output and
	  python-xmltodict for xml parsing. PYTHON3_PYEXPAT is required
	  for xml and plist parsers.

	  https://github.com/kellyjonbrazil/jc
```

## package/python-multidict/Config.in
```kconfig
config BR2_PACKAGE_PYTHON_MULTIDICT
	bool "python-multidict"
	select BR2_PACKAGE_PYTHON_TYPING_EXTENSIONS # runtime
	help
	  Multidict is dict-like collection of key-value pairs where a
	  key may occur more than once in the container.

	  https://github.com/aio-libs/multidict
```

## package/python-pybind11/Config.in
```kconfig
config BR2_PACKAGE_PYTHON_PYBIND11
	bool "python-pybind11"
	help
	  PyBind is a lightweight header-only library that exposes C++
	  types in Python and vice versa, mainly to create Python
	  bindings of existing C++ code.

	  http://pybind11.readthedocs.org/en/master

comment "python-pybind needs a toolchain w/ C++"
	depends on !BR2_INSTALL_LIBSTDCPP
```

## package/python-pyopenssl/Config.in
```kconfig
config BR2_PACKAGE_PYTHON_PYOPENSSL
	bool "python-pyopenssl"
	select BR2_PACKAGE_PYTHON_CRYPTOGRAPHY # runtime
	select BR2_PACKAGE_PYTHON_TYPING_EXTENSIONS # runtime
	help
	  Python wrapper module around the OpenSSL library.

	  https://pyopenssl.org/
```

## package/python-scikit-build-core/Config.in
```kconfig
config BR2_PACKAGE_PYTHON_SCIKIT_BUILD_CORE
	bool "python-scikit-build-core"
	help
	  Build backend for CMake based projects.

	  https://github.com/scikit-build/scikit-build-core
```

## package/python-vcs-versioning/Config.in
```kconfig
config BR2_PACKAGE_PYTHON_VCS_VERSIONING
	bool "python-vcs-versioning"
	select BR2_PACKAGE_PYTHON_PACKAGING # runtime
	select BR2_PACKAGE_PYTHON_TOMLI # runtime
	select BR2_PACKAGE_PYTHON_TYPING_EXTENSIONS # runtime
	help
	  the blessed package to manage your versions by vcs metadata.
```

## package/qt6/qt6speech/Config.in
```kconfig
config BR2_PACKAGE_QT6SPEECH
	bool "qt6speech"
	select BR2_PACKAGE_QT6MULTIMEDIA
	help
	  This package provides the Qt TextToSpeech module:

	  https://code.qt.io/cgit/qt/qtspeech.git
	  https://doc.qt.io/qt-6/qttexttospeech-index.html
```

## package/sdl3_image/Config.in
```kconfig
config BR2_PACKAGE_SDL3_IMAGE
	bool "sdl3_image"
	depends on BR2_PACKAGE_SDL3
	select BR2_PACKAGE_WEBP
	select BR2_PACKAGE_WEBP_DEMUX
	select BR2_PACKAGE_LIBAVIF
	select BR2_PACKAGE_TIFF
	help
	  SDL3_image is an image file loading library. It loads images
	  as SDL surfaces, and supports the following formats: BMP,
	  GIF, JPEG, LBM, PCX, PNG, PNM, TGA, TIFF, XCF, XPM, XV.

	  http://www.libsdl.org/projects/SDL_image/
```

## package/tpm2-tss-engine/Config.in
```kconfig
config BR2_PACKAGE_TPM2_TSS_ENGINE
	bool "tpm2-tss-engine"
	select BR2_PACKAGE_TPM2_TSS
	select BR2_PACKAGE_LIBOPENSSL_ENGINES
	help
	  The tpm2-tss-engine project implements a cryptographic engine
	  for OpenSSL for Trusted Platform Module (TPM 2.0) using the
	  tpm2-tss software stack that follows the Trusted Computing
	  Groups (TCG) TPM Software Stack (TSS 2.0). It uses the
	  Enhanced System API (ESAPI) interface of the TSS 2.0 for
	  downwards communication. It supports RSA decryption and
	  signatures as well as ECDSA signatures.

if BR2_PACKAGE_TPM2_TSS_ENGINE

config BR2_PACKAGE_TPM2_TSS_ENGINE_DIGEST_SIGN
	bool "enable digest and sign support"
	help
	  Enable digest-sign hash operations on the TPM.

endif
```
